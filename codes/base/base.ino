// ===== OLED SETUP
//OLED icin gerekli olan kutuphanelerin import edilmesi
#include <SPI.h>
#include <Wire.h>
#include <Adafruit_GFX.h>
#include <Adafruit_SH110X.h>

//OLED'in I2C adresini tutan degisken
#define i2c_Address 0x3c 

// OLED olculerini tutan genislik ve yukseklik degiskenleri (piksel cinsinden)
#define SCREEN_WIDTH 128
#define SCREEN_HEIGHT 64

// OLED'in RESET pininin NodeMCU'ya baglandigi pin numarasi
// NOT: NodeMCU RESET butonunun pinini kullanmak icin '-1' verin.
#define OLED_RESET -1

Adafruit_SH1106G display = Adafruit_SH1106G(SCREEN_WIDTH, SCREEN_HEIGHT, &Wire, OLED_RESET);


// ===== WI-FI SETUP.
#include "ESP8266WiFi.h"

// WiFi parameters to be configured
const char* ssid = "TURKSAT-KABLONET-2.4G-tV1U";
const char* password = "JkVScMq8TGao";

// ====== CLIENT SETUP FOR HTTP REQUESTS
#include <ArduinoJson.h> //https://github.com/bblanchon/ArduinoJson
WiFiClient client; //Use WiFiClientSecure for HTTPS.
#define HOST "192.168.0.6" //host server
#define HOST_PORT 8080
#define TOKEN "derslik2cihaz"


// ===== RFID SETUP
#include <MFRC522.h>
MFRC522 rfid(0,16);//RFID Chip Select ve Reset pinlerinin ayarlarını yapıyoruz. 
boolean Yetki;

// ==== DEFINE BITMAPS FOR LOGOS

  //logoyu tutan HEX array
const unsigned char fuBitmap [] PROGMEM = {
	// 'logo, 50x50px
	0x00, 0x00, 0x00, 0x00, 0x00, 0x00, 0x00, 0x00, 0x00, 0x00, 0x00, 0x00, 0x00, 0x00, 0x00, 0x00, 
	0x00, 0x00, 0x00, 0x00, 0x00, 0x00, 0x00, 0x00, 0x00, 0x00, 0x00, 0x00, 0x1f, 0xff, 0xff, 0xff, 
	0xff, 0xfe, 0x00, 0x1f, 0xff, 0xff, 0xff, 0xff, 0xfe, 0x00, 0x1c, 0x00, 0x00, 0x30, 0x00, 0x0e, 
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	0x00, 0x00, 0x00, 0x00, 0x00, 0x00, 0x00, 0x00, 0x00, 0x00, 0x00, 0x00, 0x00, 0x00
};

static const unsigned char loadingBitmap [] PROGMEM = {
	0x00, 0x00, 0x03, 0xf0, 0x00, 0x80, 0x00, 0x00, 0x00, 0x3f, 0xff, 0x01, 0x80, 0x00, 0x00, 0x01, 
	0xff, 0xff, 0xe3, 0x80, 0x00, 0x00, 0x07, 0xff, 0xff, 0xff, 0x80, 0x00, 0x00, 0x0f, 0xff, 0xff, 
	0xff, 0x80, 0x00, 0x00, 0x3f, 0xff, 0xff, 0xff, 0x80, 0x00, 0x00, 0x7f, 0xff, 0xff, 0xff, 0x80, 
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	0x00, 0x08, 0x00, 0x00, 0x00, 0x00, 0x00, 0x00, 0x00, 0x00, 0x00, 0x00, 0x00, 0x00
};

static const unsigned char rfidBitmap [] PROGMEM = {
	0x00, 0x00, 0x00, 0xff, 0x80, 0x00, 0x00, 0x00, 0x00, 0x0f, 0xff, 0xf0, 0x00, 0x00, 0x00, 0x00, 
	0x3f, 0xff, 0xfc, 0x00, 0x00, 0x00, 0x00, 0xff, 0xc1, 0xff, 0x00, 0x00, 0x00, 0x01, 0xfc, 0x00, 
	0x1f, 0x80, 0x00, 0x00, 0x03, 0xf0, 0x00, 0x07, 0xe0, 0x00, 0x00, 0x03, 0xc1, 0xff, 0x01, 0xf0, 
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	0x7f, 0xff, 0xff, 0xff, 0xff, 0x00, 0x00, 0x1f, 0xff, 0xff, 0xff, 0xfc, 0x00, 0x00
};

static const unsigned char wirelessBitmap [] PROGMEM = {
	0x00, 0x00, 0x00, 0x00, 0x00, 0x00, 0x00, 0x00, 0x00, 0x00, 0x00, 0x00, 0x00, 0x00, 0x00, 0x00, 
	0x00, 0x00, 0x00, 0x00, 0x00, 0x00, 0x00, 0x00, 0x00, 0x00, 0x00, 0x00, 0x00, 0x00, 0x00, 0x00, 
	0x00, 0x00, 0x00, 0x00, 0x00, 0x0f, 0xfc, 0x00, 0x00, 0x00, 0x00, 0x01, 0xff, 0xff, 0xe0, 0x00, 
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	0x00, 0x00, 0x00, 0x00, 0x00, 0x00, 0x00, 0x00, 0x00, 0x00, 0x00, 0x00, 0x00, 0x00
};

static const unsigned char cardBitmap [] PROGMEM = {
	0x00, 0x00, 0x00, 0x00, 0x00, 0x00, 0x00, 0x00, 0x00, 0x03, 0xf0, 0x00, 0x00, 0x00, 0x00, 0x00, 
	0x07, 0xf8, 0x00, 0x00, 0x00, 0x00, 0x00, 0x07, 0xf8, 0x00, 0x00, 0x00, 0x00, 0x00, 0x7f, 0x3f, 
	0x80, 0x00, 0x00, 0x00, 0x00, 0xfe, 0x1f, 0xc0, 0x00, 0x00, 0x00, 0x00, 0xfe, 0x1f, 0xc0, 0x00, 
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	0x00, 0x00, 0x00, 0x00, 0x00, 0x00, 0x00, 0x00
};

static const unsigned char xBitmap [] PROGMEM = {
	0x00, 0x00, 0x0f, 0xfc, 0x00, 0x00, 0x00, 0x00, 0x00, 0xff, 0xff, 0xc0, 0x00, 0x00, 0x00, 0x03, 
	0xff, 0xff, 0xf0, 0x00, 0x00, 0x00, 0x0f, 0xff, 0xff, 0xfc, 0x00, 0x00, 0x00, 0x1f, 0xe0, 0x01, 
	0xfe, 0x00, 0x00, 0x00, 0x7f, 0x80, 0x00, 0x7f, 0x80, 0x00, 0x00, 0xfe, 0x00, 0x00, 0x1f, 0xc0, 
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	0x00, 0x00, 0x7f, 0xff, 0x80, 0x00, 0x00, 0x00, 0x00, 0x0f, 0xfc, 0x00, 0x00, 0x00
};

static const unsigned char tickBitmap [] PROGMEM = {
	0x00, 0x00, 0x00, 0x00, 0x00, 0x00, 0x00, 0x00, 0x00, 0x1f, 0xf0, 0x00, 0x00, 0x00, 0x00, 0x00, 
	0xff, 0xff, 0x00, 0x00, 0x00, 0x00, 0x07, 0xff, 0xff, 0xc0, 0x00, 0x00, 0x00, 0x0f, 0xff, 0xff, 
	0xf0, 0x0c, 0x00, 0x00, 0x3f, 0xfc, 0x3f, 0xf8, 0x1e, 0x00, 0x00, 0x7f, 0x80, 0x03, 0xfe, 0x3f, 
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	0x00, 0x00, 0x00, 0x00, 0x00, 0x00, 0x00, 0x00, 0x00, 0x00, 0x00, 0x00, 0x00, 0x00
};

static const unsigned char serverBitmap [] PROGMEM = {
	// 'logo, 50x50px
	0x00, 0x00, 0x00, 0x00, 0x00, 0x00, 0x00, 0x00, 0x00, 0x00, 0x00, 0x00, 0x00, 0x00, 0x00, 0x00, 
	0x00, 0x00, 0x00, 0x00, 0x00, 0x00, 0x00, 0x00, 0x00, 0x00, 0x00, 0x00, 0x00, 0x00, 0x00, 0x00, 
	0x00, 0x00, 0x00, 0x00, 0x3f, 0xff, 0xff, 0xff, 0x00, 0x00, 0x00, 0x60, 0x00, 0x00, 0x01, 0x80, 
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	0x00, 0x00, 0x00, 0x00, 0x00, 0x00, 0x00, 0x00, 0x00, 0x00, 0x00, 0x00, 0x00, 0x00
};




void setup(){
  Serial.begin(9600);
  //OLED ekrani baslat.
  oledStart();
  delay(500);

  //RFID'yi baslat.
  rfidStart();
  delay(500);

  //Wi-Fi'ya baglan.
  connectWifi();
  delay(500);

  //Sunucuya test baglantisi at.
  pingRemoteHost();
  delay(2000);
}

// Kisi basarili bir sekilde tanindiysa bu fonksiyon calisir.
void viewTick(){
  display.clearDisplay();
  display.drawBitmap(39,0,tickBitmap,50,50,1);

  //Ekranda "TICK" goster.
  display.setTextSize(1);
  display.setTextColor(SH110X_WHITE);
  display.setCursor(10, 56); //imleci (10,56) koordinatina tasi.
  display.println("Yoklama alindi.");
  display.display();
}

// Kisi taninmadiysa bu fonksiyon calisir.
void viewX(){
  display.clearDisplay();
  display.drawBitmap(39,0,xBitmap,50,50,1);

  //Ekranda "X" goster.
  display.setTextSize(1);
  display.setTextColor(SH110X_WHITE);
  display.setCursor(10, 56); //imleci (10,56) koordinatina tasi.
  display.println("Bu derse katilamazsiniz!");
  display.display();
}


// Kart okutulmadigi anlarda calisacak fonksiyon.
void pressCardInfo(){
  display.clearDisplay();
  display.drawBitmap(39,0,cardBitmap,50,40,1);

  //Ekranda "KART LOGOSU" goster.
  display.setTextSize(1);
  display.setTextColor(SH110X_WHITE);
  display.setCursor(10, 56); //imleci (10,56) koordinatina tasi.
  display.println("Kartinizi okutunuz.");
  display.display();
}

// Wi-Fi'a baglan.
void connectWifi(){
  display.clearDisplay();
  display.drawBitmap(39,0,wirelessBitmap,50,50,1);

  //Ekrana "Wi-Fi'a baglaniliyor." yaz.
  display.setTextSize(1);
  display.setTextColor(SH110X_WHITE);
  display.setCursor(10, 56); //imleci (10,56) koordinatina tasi.
  display.println("Wi-Fi baglaniliyor.");
  display.display();

  WiFi.begin(ssid, password);
  while (WiFi.status() != WL_CONNECTED) {
     delay(500);
     Serial.print(".");
  }
  Serial.println("WiFi connected");
  // Print the IP address
  Serial.println(WiFi.localIP());
}

// SPI ile RFID'ye baglan ve kullaniciyi bilgilendir.
void rfidStart(){
  display.clearDisplay();
  display.drawBitmap(39,0,rfidBitmap,50,50,1);

  //Ekrana "RFID baslatiliyor." yaz.
  display.setTextSize(1);
  display.setTextColor(SH110X_WHITE);
  display.setCursor(10, 56); //imleci (10,56) koordinatina tasi.
  display.println("RFID baslatiliyor.");
  display.display();

  SPI.begin();
  rfid.PCD_Init();
}

// OLED ekrani baslat.
void oledStart(){
  //Display'e 0x3C adresinden I2C protokolu ile baglan.
  display.begin(i2c_Address, true);
  //Display buffer'ini temizle.
  display.clearDisplay();
  delay(2000);

  //Logoyu ekranda goster.
  display.drawBitmap(39,0,fuBitmap,50,50,1);

  //Ekrana "Firat Universitesi" yaz.
  display.setTextSize(1);
  display.setTextColor(SH110X_WHITE);
  display.setCursor(10, 56); //imleci (10,56) koordinatina tasi.
  display.println("Firat Universitesi");
  display.display();
}

void pingRemoteHost(){
  display.clearDisplay();
  display.drawBitmap(39,0,serverBitmap,50,50,1);

  //Ekrana "Sunucuya baglaniliyor." yaz.
  display.setTextSize(1);
  display.setTextColor(SH110X_WHITE);
  display.setCursor(10, 56); //imleci (10,56) koordinatina tasi.
  display.println("Sunucu baglantisi");
  display.display();

  if (!client.connect(HOST, 8080))
  {
    Serial.println(F("Connection failed"));
    return;
  }
}

void makeHttpRequest(byte Kart[4]){
  // Connect to remote host with IP address and port number.
  if (!client.connect(HOST, 8080))
  {
    Serial.println(F("Connection failed"));
    return;
  }
  yield();
  Serial.println("Remote host connection success.");
  // Create HTTP Request with GET method.
  client.print(F("GET /api/varYaz?cihazToken=derslik2cihaz&rfidKodu="));
  for(int i=0;i<4;i++){
    client.print(Kart[i]);
  }
  client.println(F(" HTTP/1.1"));
  //Headers
  client.print(F("Host: "));
  client.print(HOST);
  client.print(":");
  client.println(HOST_PORT);
  // Basic Authentication (Created with POSTMAN Code Snippet.)
  client.print(F("Authorization: "));
  client.print("Basic ");
  client.println("MTAwNTIwNzA6ZGVuZW1l");
  
  // !!! DON'T DELETE. It's for waiting request. !!!
  if (client.println() == 0){
    Serial.println(F("Failed to send request"));
    return;
  }

  // Check HTTP status
  char status[32] = {0};
  client.readBytesUntil('\r', status, sizeof(status));
  Serial.println(status);
  if (strcmp(status, "HTTP/1.1 200 ") != 0)
  {
    Serial.print(F("Unexpected response: "));
    Serial.println(status);
    return;
  }

  // Skip HTTP headers
  char endOfHeaders[] = "\r\n\r\n";
  if (!client.find(endOfHeaders))
  {
    Serial.println(F("Invalid response"));
    return;
  }

  // NOT REQUIRED : Print coming response from remote host.
  //  while (client.available()) {
  //    char c = 0;
  //    client.readBytes(&c, 1);
  //    Serial.print(c);
  //  }

  //Pass unvalid characters.
  Serial.println((char)client.read());
  Serial.println((char)client.read());

  // Deserialize JSON
  //StaticJsonDocument<192> doc;
  DynamicJsonDocument doc(192); //For ESP32/ESP8266 you'll mainly use dynamic.
  DeserializationError error = deserializeJson(doc, client);
  if (!error) {
    const char* message = doc["message"];
    Serial.print("message: ");
    Serial.println(message);
    if(strcmp(message,"Yoklama alındı!")==0){
      Serial.println("BASARILI!!!!!!!!!!!!!");
      Yetki=true;
    } 
    else {
      Serial.println("BASARISIZ!!!!!");
      Yetki=false;
    }
  }
  else {
    Serial.print(F("deserializeJson() failed: "));
    Serial.println(error.f_str());
    return;
  }
}


void loop() {
  pressCardInfo();

  //RFID looping
  Yetki = true;
  if ( rfid.PICC_IsNewCardPresent()){ 
    if ( rfid.PICC_ReadCardSerial()){
      byte Kart[4];
      for (int i = 0; i < 4; i++){
        Kart[i]=rfid.uid.uidByte[i];
        Serial.println(Kart[i]);
      }
      makeHttpRequest(Kart);
    }
    Serial.println(Yetki);
    if(Yetki==false){
      viewX();
      delay(3000);
    }
    else{
      viewTick();
      delay(3000);
    }
  }
}